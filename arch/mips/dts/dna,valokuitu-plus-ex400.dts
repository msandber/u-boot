// SPDX-License-Identifier: GPL-2.0
/*
 * Copyright (C) 2024 Mauri Sandberg
 *
 */

/dts-v1/;

#include "genexis,pulse-ex400-common.dtsi"

/ {
	compatible = "dna,valokuitu-plus-ex400", "mediatek,mt7621-soc";
	model = "DNA Valokuitu Plus EX400";
};
